## Documentation/devicetree/bindings/display/panel/oneplus,aa590.yaml
```yaml
$id: http://devicetree.org/schemas/display/panel/oneplus,aa590.yaml#
$schema: http://devicetree.org/meta-schemas/core.yaml#

title: OnePlus AA590 1264x2780 AMOLED panel

maintainers:
  - Sui-KP <Sui-KP@outlook.com>

allOf:
  - $ref: panel-common.yaml#

properties:
  compatible:
    const: oneplus,aa590

  reg:
    maxItems: 1

  reset-gpios:
    maxItems: 1

  enable-gpios:
    maxItems: 1

  vddio-supply: true

  vci-supply: true

  port: true

required:
  - compatible
  - reg
  - reset-gpios
  - enable-gpios
  - vddio-supply
  - vci-supply
  - port

unevaluatedProperties: false
```

## drivers/power/oplus/Kconfig
```kconfig
menuconfig OPLUS_CHARGER
	bool "OPLUS charging system"
	depends on I2C
	select REGMAP_I2C

if OPLUS_CHARGER

config OPLUS_CHG_V2
	tristate "OPLUS charging V2 system"
	depends on POWER_SUPPLY && QCOM_PMIC_GLINK

if OPLUS_CHG_V2
source "drivers/power/oplus/v2/Kconfig"
endif

endif
```
