&{/reserved-memory/android_ramoops@880000000} {
	compatible = "ramoops";
	record-size = <0>;
	console-size = <0x40000>;
	pmsg-size = <0x200000>;
	ftrace-size = <0>;
	mem-type = <0>;
};

&{/firmware} {
	status = "disabled";
};

&{/interconnect-0} {
	status = "disabled";
};

&{/interconnect-1} {
	status = "disabled";
};

&{/pmu} {
	status = "disabled";
};

&{/smp2p-adsp} {
	status = "okay";
};

&{/smp2p-cdsp} {
	status = "disabled";
};

&{/smp2p-modem} {
	status = "disabled";
};

&{/soc@0/clock-controller@100000} {
	status = "disabled";
};

&{/soc@0/mailbox@406000} {
	status = "disabled";
};

&{/soc@0/dma-controller@800000} {
	status = "disabled";
};

&{/soc@0/geniqup@8c0000} {
	status = "disabled";
};

&{/soc@0/geniqup@9c0000} {
	status = "disabled";
};

&{/soc@0/dma-controller@a00000} {
	status = "disabled";
};

&{/soc@0/geniqup@ac0000} {
	status = "disabled";
};

&{/soc@0/rng@10c3000} {
	status = "disabled";
};

&{/soc@0/interconnect@1500000} {
	status = "disabled";
};

&{/soc@0/interconnect@1600000} {
	status = "disabled";
};

&{/soc@0/interconnect@1680000} {
	status = "disabled";
};

&{/soc@0/interconnect@16c0000} {
	status = "disabled";
};

&{/soc@0/interconnect@16e0000} {
	status = "disabled";
};

&{/soc@0/interconnect@1700000} {
	status = "disabled";
};

&{/soc@0/clock-controller@1760000} {
	status = "disabled";
};

&{/soc@0/crypto@1d88000} {
	status = "disabled";
};

&{/soc@0/dma-controller@1dc4000} {
	status = "disabled";
};

&{/soc@0/crypto@1dfa000} {
	status = "disabled";
};

&{/soc@0/hwlock@1f40000} {
	status = "disabled";
};

&{/soc@0/remoteproc@4080000} {
	status = "disabled";
};

&{/soc@0/remoteproc@6800000} {
	status = "disabled";
};

&{/soc@0/codec@6aa0000} {
	status = "disabled";
};

&{/soc@0/soundwire@6ab0000} {
	status = "disabled";
};

&{/soc@0/codec@6ac0000} {
	status = "okay";
};

&{/soc@0/soundwire@6ad0000} {
	status = "okay";
};

&{/soc@0/codec@6ae0000} {
	status = "okay";
};

&{/soc@0/codec@6b00000} {
	status = "disabled";
};

&{/soc@0/soundwire@6b10000} {
	status = "disabled";
};

&{/soc@0/interconnect@7e40000} {
	status = "disabled";
};

&{/soc@0/interconnect@7400000} {
	status = "disabled";
};

&{/soc@0/interconnect@7420000} {
	status = "disabled";
};

&{/soc@0/soundwire@7630000} {
	status = "okay";
};

&{/soc@0/codec@7660000} {
	status = "okay";
};

&{/soc@0/pinctrl@7760000} {
	status = "okay";
};

&{/soc@0/mmc@8804000} {
	status = "disabled";
};

&{/soc@0/phy@88e3000} {
	status = "okay";
};

&{/soc@0/phy@88e8000} {
	status = "okay";
};

&{/soc@0/usb@a600000} {
	status = "okay";
};

&{/soc@0/video-codec@aa00000} {
	status = "disabled";
};

&{/soc@0/clock-controller@aaf0000} {
	status = "disabled";
};

&{/soc@0/clock-controller@ade0000} {
	status = "disabled";
};

&{/soc@0/interrupt-controller@b220000} {
	status = "okay";
};

&{/soc@0/thermal-sensor@c228000} {
	status = "disabled";
};

&{/soc@0/thermal-sensor@c229000} {
	status = "disabled";
};

&{/soc@0/thermal-sensor@c22a000} {
	status = "disabled";
};

&{/soc@0/thermal-sensor@c22b000} {
	status = "disabled";
};

&{/soc@0/power-management@c300000} {
	status = "disabled";
};

&{/soc@0/sram@c3f0000} {
	status = "disabled";
};

&{/soc@0/spmi@c400000} {
	status = "okay";
};

&pon_pwrkey {
	status = "okay";
};

&{/soc@0/pinctrl@f100000} {
	status = "disabled";
};

&{/soc@0/clock-controller@f204008} {
	status = "disabled";
};

&{/soc@0/stm@10002000} {
	status = "disabled";
};

&{/soc@0/tpda@10004000} {
	status = "disabled";
};

&{/soc@0/tpdm@1000f000} {
	status = "disabled";
};

&{/soc@0/funnel@10041000} {
	status = "disabled";
};

&{/soc@0/tpdm@10800000} {
	status = "disabled";
};

&{/soc@0/tpda@10803000} {
	status = "disabled";
};

&{/soc@0/funnel@10804000} {
	status = "disabled";
};

&{/soc@0/cti@1080b000} {
	status = "disabled";
};

&{/soc@0/tpdm@1082c000} {
	status = "disabled";
};

&{/soc@0/tpdm@10841000} {
	status = "disabled";
};

&{/soc@0/tpdm@1084e000} {
	status = "disabled";
};

&{/soc@0/tpdm@1084f000} {
	status = "disabled";
};

&{/soc@0/tpdm@10850000} {
	status = "disabled";
};

&{/soc@0/tpda@10851000} {
	status = "disabled";
};

&{/soc@0/tpdm@10980000} {
	status = "disabled";
};

&{/soc@0/tpda@10986000} {
	status = "disabled";
};

&{/soc@0/funnel@10987000} {
	status = "disabled";
};

&{/soc@0/cti@1098b000} {
	status = "disabled";
};

&{/soc@0/tpdm@109a3000} {
	status = "disabled";
};

&{/soc@0/tpdm@109a4000} {
	status = "disabled";
};

&{/soc@0/tpdm@109a5000} {
	status = "disabled";
};

&{/soc@0/tpdm@109a6000} {
	status = "disabled";
};

&{/soc@0/tpdm@109a7000} {
	status = "disabled";
};

&{/soc@0/tpdm@109a8000} {
	status = "disabled";
};

&{/soc@0/tpdm@109a9000} {
	status = "disabled";
};

&{/soc@0/tpdm@109aa000} {
	status = "disabled";
};

&{/soc@0/tn@109ab000} {
	status = "disabled";
};

&{/soc@0/tpdm@109d0000} {
	status = "disabled";
};

&{/soc@0/funnel@10b04000} {
	status = "disabled";
};

&{/soc@0/tmc@10b05000} {
	status = "disabled";
};

&{/soc@0/tpda@10b08000} {
	status = "disabled";
};

&{/soc@0/tpdm@10b09000} {
	status = "disabled";
};

&{/soc@0/tpdm@10b0a000} {
	status = "disabled";
};

&{/soc@0/tpdm@10b0b000} {
	status = "disabled";
};

&{/soc@0/tpdm@10b0c000} {
	status = "disabled";
};

&{/soc@0/tpdm@10b0d000} {
	status = "disabled";
};

&{/soc@0/iommu@15000000} {
	status = "disabled";
};

&{/soc@0/pcie@1c00000} {
	status = "disabled";
};

&{/soc@0/phy@1c06000} {
	status = "disabled";
};

&{/soc@0/phy@1d80000} {
	status = "disabled";
};

&{/soc@0/ufs@1d84000} {
	status = "disabled";
};

&{/soc@0/mailbox@16430000} {
	status = "disabled";
};

&{/soc@0/rsc@16500000} {
	status = "disabled";
};

&{/soc@0/timer@16800000} {
	status = "disabled";
};

&{/soc@0/sram@17b4e000} {
	status = "disabled";
};

&{/soc@0/pmu@240b3400} {
	status = "disabled";
};

&{/soc@0/pmu@240b7400} {
	status = "disabled";
};

&{/soc@0/interconnect@24100000} {
	status = "disabled";
};

&{/soc@0/interconnect@320c0000} {
	status = "disabled";
};

&{/soc@0/remoteproc@32300000} {
	status = "disabled";
};

&{/thermal-zones} {
	status = "disabled";
};

&{/tpdm-cdsp-llm} {
	status = "disabled";
};

&{/tpdm-cdsp-llm2} {
	status = "disabled";
};

&{/tpdm-modem1} {
	status = "disabled";
};

&{/reboot-mode} {
	status = "disabled";
};

&{/clocks} {
	status = "disabled";
};

&{/vph-pwr-regulator} {
	status = "disabled";
};

&cpu0 {
	/delete-property/ power-domains;
	/delete-property/ power-domain-names;
};

&cpu1 {
	/delete-property/ power-domains;
	/delete-property/ power-domain-names;
};

&cpu2 {
	/delete-property/ power-domains;
	/delete-property/ power-domain-names;
};

&cpu3 {
	/delete-property/ power-domains;
	/delete-property/ power-domain-names;
};

&cpu4 {
	/delete-property/ power-domains;
	/delete-property/ power-domain-names;
};

&cpu5 {
	/delete-property/ power-domains;
	/delete-property/ power-domain-names;
};

&cpu6 {
	/delete-property/ power-domains;
	/delete-property/ power-domain-names;
};

&cpu7 {
	/delete-property/ power-domains;
	/delete-property/ power-domain-names;
};

&{/reserved-memory/aop_cmd_db_region@81c60000} {
	/delete-property/ compatible;
};

&{/reserved-memory/smem_region@81d00000} {
	compatible = "qcom,smem";
};

&{/reserved-memory/android_ramoops@880000000} {
	mem-type = <2>;
};
#include "sm8750-oneplus-hummer-regulators.dtsi"

&{/firmware} {
	status = "okay";
};

&{/firmware/scmi} {
	status = "disabled";
};

&{/clocks} {
	status = "okay";
};

&vph_pwr {
	status = "okay";
};

&{/reserved-memory/aop_cmd_db_region@81c60000} {
	compatible = "qcom,cmd-db";
};

&apps_rsc {
	/delete-property/ power-domains;
	status = "okay";
};

&gcc {
	status = "okay";
};

&tcsrcc {
	status = "okay";
};

&mc_virt {
	status = "okay";
};

&config_noc {
	status = "okay";
};

&cnoc_main {
	status = "okay";
};

&system_noc {
	status = "okay";
};

&aggre1_noc {
	status = "okay";
};

&aggre2_noc {
	status = "okay";
};

&gem_noc {
	status = "okay";
};

&tlmm {
	/delete-property/ wakeup-parent;
	status = "okay";
};

&apps_smmu {
	status = "okay";
};

&vreg_l1j_0p91 {
	regulator-min-microvolt = <912000>;
};

&ufs_mem_hc {
	/delete-property/ qcom,ice;
};

&rpmhpd {
	oneplus,keep-unclaimed-rpmh-votes;
};

&scm {
	status = "disabled";
};

&{/reserved-memory/mu_dxe_heap@bd930000} {
	/delete-property/ no-map;
};

&{/reserved-memory/mu_dxe_heap_tail@d5100000} {
	/delete-property/ no-map;
};

&scm {
	status = "okay";
};

&tlmm {
	gpio-reserved-ranges = <0 2>, <3 13>, <17 7>, <28 16>, <46 2>, <52 14>, <68 4>, <74 12>, <87 11>, <99 2>, <105 16>, <125 36>, <165 41>, <208 7>;

	mi2s1_sck_active: mi2s1-sck-active-state {
		pins = "gpio121";
		function = "i2s1_sck";
		drive-strength = <8>;
		bias-disable;
	};

	mi2s1_ws_active: mi2s1-ws-active-state {
		pins = "gpio123";
		function = "i2s1_ws";
		drive-strength = <8>;
		bias-disable;
	};

	mi2s1_sd0_active: mi2s1-sd0-active-state {
		pins = "gpio122";
		function = "i2s1_data0";
		drive-strength = <8>;
		bias-disable;
	};

	mi2s1_sd1_active: mi2s1-sd1-active-state {
		pins = "gpio124";
		function = "i2s1_data1";
		drive-strength = <8>;
		bias-disable;
	};

	wcd939x_reset_active: wcd939x-reset-active-state {
		pins = "gpio101";
		function = "gpio";
		drive-strength = <16>;
		bias-disable;
		output-high;
	};

	sia91xx_gpio_L: sia91xx-gpio-left-state {
		pins = "gpio2";
		function = "gpio";
		drive-strength = <6>;
		bias-disable;
	};

	sia91xx_gpio_R: sia91xx-gpio-right-state {
		pins = "gpio164";
		function = "gpio";
		drive-strength = <6>;
		bias-disable;
	};

	touch_reset_default: touch-reset-default-state {
		pins = "gpio161";
		function = "gpio";
		drive-strength = <2>;
		bias-disable;
	};

	touch_irq_default: touch-irq-default-state {
		pins = "gpio162";
		function = "gpio";
		drive-strength = <2>;
		bias-disable;
		input-enable;
	};
};

&ufs_mem_phy {
	status = "okay";
};

&ufs_mem_hc {
	status = "okay";
};

&aoss_qmp {
	status = "okay";
};

&ipcc {
	status = "okay";
};

&clk_virt {
	status = "okay";
};

&gpi_dma1 {
	dma-coherent;
	status = "okay";
};

&qupv3_1 {
	status = "okay";
};

&i2c3 {
	status = "okay";

	wcd939x_i2c@e {
		compatible = "qcom,wcd939x-i2c";
		reg = <0xe>;
		vdd-supply = <&vreg_l15b_1p8>;
	};
};

&vreg_l4b_1p8 {
	status = "okay";
};

&vreg_l2d_0p88 {
	status = "okay";
};

&vreg_l5b_3p1 {
	status = "okay";
};

&vreg_l15b_1p8 {
	status = "okay";
};

&vreg_l16b_2p8 {
	regulator-min-microvolt = <3104000>;
	regulator-max-microvolt = <3104000>;
	status = "okay";
};

&spi4 {
	status = "okay";

	touchscreen@0 {
		compatible = "synaptics,s3910";
		reg = <0>;
		spi-max-frequency = <19000000>;
		interrupt-parent = <&tlmm>;
		interrupts = <162 IRQ_TYPE_LEVEL_LOW>;
		reset-gpios = <&tlmm 161 GPIO_ACTIVE_LOW>;
		vddio-supply = <&vreg_l4b_1p8>;
		avdd-supply = <&vreg_l16b_2p8>;
		pinctrl-0 = <&touch_reset_default &touch_irq_default>;
		pinctrl-names = "default";
	};
};

&{/} {
	wcn786x-pmu {
		compatible = "qcom,wcn7861-pmu";
		qcom,qmp = <&aoss_qmp>;
		qcom,pdc-init-table =
			"{class: wlan_pdc, ss: rf, res: s5f.m, enable: 1}",
			"{class: wlan_pdc, ss: rf, res: s5f.v, enable: 1}",
			"{class: wlan_pdc, ss: rf, res: s5f.v, upval: 876}",
			"{class: wlan_pdc, ss: rf, res: s5f.v, dwnval: 876}";
		qcom,vreg-pdc-map = "s5f:rf", "s4d:bb", "s3g:rf", "s7i:rf";
		qcom,pmu-vreg-map =
			"VDDD_AON_0P9:s5f", "VDDA_RFA_1P9:s3g",
			"VDDA_RFA_1P3:s7i", "VDDA_RFA_0P9:s5f",
			"VDDD_WLMX_0P9:s4d", "VDDD_WLCX_0P9:s5f",
			"VDDD_BTCX_0P9:s5f", "VDDD_BTCMX_0P9:s5f",
			"VDDA_PCIE_1P2:s7i", "VDDA_PCIE_0P9:s7i";
		pinctrl-names = "default";
		pinctrl-0 = <&wlan_en_default &bt_en_default>;
		wlan-enable-gpios = <&tlmm 16 GPIO_ACTIVE_HIGH>;
		bt-enable-gpios = <&pm8550ve_f_gpios 3 GPIO_ACTIVE_HIGH>;
		clocks = <&rpmhcc RPMH_RF_CLK1>;
		vdd-supply = <&vreg_s5f_0p85>;
		vddio-supply = <&vreg_l3f_1p8>;
		vddio1p2-supply = <&vreg_l2f_1p2>;
		vddaon-supply = <&vreg_s4d_0p85>;
		vdddig-supply = <&vreg_s5f_0p85>;
		vddrfa1p2-supply = <&vreg_s7i_1p2>;
		vddrfa1p8-supply = <&vreg_s3g_1p8>;

	};
};

&tlmm {
	wlan_en_default: wlan-en-default-state {
		pins = "gpio16";
		function = "gpio";
		drive-strength = <2>;
		bias-pull-down;
	};
};

&pm8550ve_f_gpios {
	bt_en_default: bt-en-default-state {
		pins = "gpio3";
		function = "normal";
		output-enable;
		bias-disable;
		power-source = <1>;
	};
};

&{/} {
	aliases {
		serial0 = &uart14;
	};
};

&qupv3_2 {
	status = "okay";
};

&i2c_master_hub_0 {
	status = "okay";
};

&i2c_hub_1 {
	status = "okay";
};

&i2c_hub_4 {
	status = "okay";
	qcom,clk-freq-out = <400000>;

	sipa_i2c_L: sipa91xx_i2c@6c {
		compatible = "si,sia91xx-i2c";
		reg = <0x6c>;
		#sound-dai-cells = <0>;
		si,sipa-dev = <&sia91xx_L>;
		sound-name-prefix = "SpkrLeft";
	};

	sipa_i2c_R: sipa91xx_i2c@6d {
		compatible = "si,sia91xx-i2c";
		reg = <0x6d>;
		#sound-dai-cells = <0>;
		si,sipa-dev = <&sia91xx_R>;
		sound-name-prefix = "SpkrRight";
	};
};

&soc {
	battery_charger: battery-charger {};
};

&soc {
	sia91xx_L: sia91xx@L {
		compatible = "si,sia91xx";
		si,si_pa_type = "sia9177";
		si,si_pa_disable_pin = <0>;
		si,si_pa_reset = <&tlmm 2 0>;
		pinctrl-names = "si_pa_gpio";
		pinctrl-0 = <&sia91xx_gpio_L>;
		channel_num = <0>;
		sipa_min_range = <5300>;
		sipa_max_range = <7500>;
		sipa_default_mohm = <6000>;
		sipa_min_freq = <100>;
		sipa_max_freq = <2000>;
		is_use_freq = <1>;
	};

	sia91xx_R: sia91xx@R {
		compatible = "si,sia91xx";
		si,si_pa_type = "sia9177";
		si,si_pa_disable_pin = <0>;
		si,si_pa_reset = <&tlmm 164 0>;
		pinctrl-names = "si_pa_gpio";
		pinctrl-0 = <&sia91xx_gpio_R>;
		channel_num = <1>;
		sipa_min_range = <5300>;
		sipa_max_range = <7500>;
		sipa_default_mohm = <6000>;
		sipa_min_freq = <100>;
		sipa_max_freq = <2000>;
		is_use_freq = <1>;
	};
};

&uart14 {
	pinctrl-0 = <&qup_uart14_default &qup_uart14_cts_rts>;
	status = "okay";

	bluetooth {
		compatible = "qcom,wcn7850-bt";
		max-speed = <8000000>;
		local-bd-address = [00 51 52 02 bf 02];
		firmware-name = "brhbtnv20", "brhbtfw20.tlv";
	};
};

&{/soc@0/rsc@16500000/regulators-2} {
	status = "okay";
};

&vreg_s4d_0p85 {
	regulator-min-microvolt = <876000>;
	status = "okay";
};

&vreg_s5f_0p85 {
	regulator-min-microvolt = <876000>;
};

&vreg_s3g_1p8 {
	regulator-min-microvolt = <1864000>;
	regulator-initial-mode = <RPMH_REGULATOR_MODE_HPM>;
	status = "okay";
};

&vreg_s7i_1p2 {
	regulator-min-microvolt = <1312000>;
};

&vreg_l8b_1p8 {
	regulator-min-microvolt = <2800000>;
	regulator-max-microvolt = <2800000>;
	status = "okay";
};

&pcie_noc {
	status = "okay";
};

&pcie0 {
	pinctrl-names = "default";
	pinctrl-0 = <&pcie0_default_state>;
	status = "okay";
};

&pcie0_phy {
	vdda-phy-supply = <&vreg_l1f_0p88>;
	vdda-pll-supply = <&vreg_l3g_1p2>;
	status = "okay";
};

&pcieport0 {
	reset-gpios = <&tlmm 102 GPIO_ACTIVE_LOW>;
	wake-gpios = <&tlmm 104 GPIO_ACTIVE_HIGH>;

	wifi@0 {
		compatible = "pci17cb,110e";
		reg = <0x10000 0 0 0 0>;
		vddaon-supply = <&vreg_s4d_0p85>;
	};
};

&{/soc@0/remoteproc@6800000/glink-edge} {
	pmic_glink_rpmsg {
		qcom,glink-channels = "PMIC_RTR_ADSP_APPS";
	};
};

&{/smp2p-adsp} {
	status = "okay";
};

&{/soc@0/hwlock@1f40000} {
	status = "okay";
};

&lpass_ag_noc {
	status = "okay";
};

&lpass_lpiaon_noc {
	status = "okay";
};

&lpass_lpicx_noc {
	status = "okay";
};

&remoteproc_adsp {
	firmware-name = "adsp.mdt", "adsp_dtb.mdt";
	status = "okay";
};

&usb_dwc3_hs {
	remote-endpoint = <&pmic_glink_hs_in>;
};

&usb_dp_qmpphy_out {
	remote-endpoint = <&pmic_glink_ss_in>;
};

&{/} {
	pmic-glink {
		compatible = "qcom,sm8750-pmic-glink",
			     "qcom,sm8550-pmic-glink",
			     "qcom,pmic-glink";
		#address-cells = <1>;
		#size-cells = <0>;

		connector@0 {
			compatible = "usb-c-connector";
			reg = <0>;
			power-role = "dual";
			data-role = "dual";

			ports {
				#address-cells = <1>;
				#size-cells = <0>;

				port@0 {
					reg = <0>;

					pmic_glink_hs_in: endpoint {
						remote-endpoint = <&usb_dwc3_hs>;
					};
				};

				port@1 {
					reg = <1>;

					pmic_glink_ss_in: endpoint {
						remote-endpoint = <&usb_dp_qmpphy_out>;
					};
				};
			};
		};
	};
};

#include "oplus_chg/oplus-chg-24811.dtsi"

&{/} {
	wcd939x: audio-codec {
		compatible = "qcom,wcd9395-codec", "qcom,wcd9390-codec";
		pinctrl-names = "default";
		pinctrl-0 = <&wcd939x_reset_active>;
		qcom,micbias1-microvolt = <2700000>;
		qcom,micbias2-microvolt = <2700000>;
		qcom,micbias3-microvolt = <2700000>;
		qcom,micbias4-microvolt = <2700000>;
		qcom,rx-device = <&wcd_rx>;
		qcom,tx-device = <&wcd_tx>;
		reset-gpios = <&tlmm 101 GPIO_ACTIVE_LOW>;
		vdd-buck-supply = <&vreg_l15b_1p8>;
		vdd-rxtx-supply = <&vreg_l15b_1p8>;
		vdd-io-supply = <&vreg_l15b_1p8>;
		vdd-mic-bias-supply = <&vreg_bob1>;
		vdd-px-supply = <&vreg_l2i_1p2>;
		#sound-dai-cells = <1>;
	};

	sound {
		compatible = "qcom,sm8750-sndcard", "qcom,sm8450-sndcard";
		model = "OnePlus Ace 5 Pro";
		clocks = <&q6prmcc LPASS_CLK_ID_SEC_MI2S_IBIT LPASS_CLK_ATTRIBUTE_COUPLE_NO>;
		clock-names = "mi2s";
		pinctrl-names = "default";
		pinctrl-0 = <&mi2s1_sck_active &mi2s1_ws_active &mi2s1_sd0_active &mi2s1_sd1_active>;
		audio-routing = "IN1_HPHL", "HPHL_OUT",
				"IN2_HPHR", "HPHR_OUT",
				"AMIC2", "MIC BIAS2",
				"AMIC1", "MIC BIAS1",
				"AMIC3", "MIC BIAS4",
				"AMIC5", "MIC BIAS1",
				"TX SWR_INPUT0", "ADC1_OUTPUT",
				"TX SWR_INPUT1", "ADC2_OUTPUT",
				"TX SWR_INPUT3", "ADC4_OUTPUT";

		wcd-playback-dai-link {
			link-name = "WCD Playback";
			codec { sound-dai = <&wcd939x 0>, <&swr1 0>, <&lpass_rxmacro 0>; };
			cpu { sound-dai = <&q6apmbedai RX_CODEC_DMA_RX_0>; };
			platform { sound-dai = <&q6apm>; };
		};

		wcd-capture-dai-link {
			link-name = "WCD Capture";
			codec { sound-dai = <&wcd939x 1>, <&swr2 0>, <&lpass_txmacro 0>; };
			cpu { sound-dai = <&q6apmbedai TX_CODEC_DMA_TX_3>; };
			platform { sound-dai = <&q6apm>; };
		};

		speaker-dai-link {
			link-name = "Secondary MI2S Playback";
			codec { sound-dai = <&sipa_i2c_L>, <&sipa_i2c_R>; };
			cpu { sound-dai = <&q6apmbedai SECONDARY_MI2S_RX>; };
			platform { sound-dai = <&q6apm>; };
		};
	};
};

&swr1 {
	wcd_rx: codec@0,4 {
		compatible = "sdw20217010e00";
		reg = <0 4>;
		qcom,rx-port-mapping = <1 2 3 4 5 9>;
	};
};

&swr2 {
	wcd_tx: codec@0,3 {
		compatible = "sdw20217010e00";
		reg = <0 3>;
		qcom,tx-port-mapping = <2 2 3 4>;
	};
};
